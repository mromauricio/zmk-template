/*
 * PNCATEHO left-only: kscan-gpio-direct, 10 keys
 */

#include "pncateho.dtsi"

/ {
    chosen {
        zmk,kscan = &kscan0;
    };

    kscan0: kscan {
        compatible = "zmk,kscan-gpio-direct";
        label = "KSCAN";

        input-gpios
            = <&pro_micro 18 (GPIO_ACTIVE_LOW | GPIO_PULL_UP)> /* pos 0 */
            , <&pro_micro 19 (GPIO_ACTIVE_LOW | GPIO_PULL_UP)> /* pos 1 */
            , <&pro_micro 20 (GPIO_ACTIVE_LOW | GPIO_PULL_UP)> /* pos 2 */
            , <&pro_micro 21 (GPIO_ACTIVE_LOW | GPIO_PULL_UP)> /* pos 3 */
            , <&pro_micro 10 (GPIO_ACTIVE_LOW | GPIO_PULL_UP)> /* pos 4 */
            , <&pro_micro 16 (GPIO_ACTIVE_LOW | GPIO_PULL_UP)> /* pos 5 */
            , <&pro_micro 14 (GPIO_ACTIVE_LOW | GPIO_PULL_UP)> /* pos 6 */
            , <&pro_micro 15 (GPIO_ACTIVE_LOW | GPIO_PULL_UP)> /* pos 7 */
            , <&pro_micro 7  (GPIO_ACTIVE_LOW | GPIO_PULL_UP)> /* pos 8 */
            , <&pro_micro 8  (GPIO_ACTIVE_LOW | GPIO_PULL_UP)> /* pos 9 */
            ;
    };
};
